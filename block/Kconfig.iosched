## block/Kconfig.iosched
```kconfig
if BLOCK

menu "IO Schedulers"

config IOSCHED_NOOP
	bool
	default y
	---help---
	  The no-op I/O scheduler is a minimal scheduler that does basic merging
	  and sorting. Its main uses include non-disk based block devices like
	  memory devices, and specialised software or hardware environments
	  that do their own scheduling and require only minimal assistance from
	  the kernel.

config IOSCHED_TEST
	tristate "Test I/O scheduler"
	depends on DEBUG_FS
	default m
	---help---
	  The test I/O scheduler is a duplicate of the noop scheduler with
	  addition of test utlity.
	  It allows testing a block device by dispatching specific requests
	  according to the test case and declare PASS/FAIL according to the
	  requests completion error code.

config IOSCHED_DEADLINE
	tristate "Deadline I/O scheduler"
	default y
	---help---
	  The deadline I/O scheduler is simple and compact. It will provide
	  CSCAN service with FIFO expiration of requests, switching to
	  a new point in the service tree and doing a batch of IO from there
	  in case of expiry.

config IOSCHED_CFQ
	tristate "CFQ I/O scheduler"
	default y
	---help---
	  The CFQ I/O scheduler tries to distribute bandwidth equally
	  among all processes in the system. It should provide a fair
	  and low latency working environment, suitable for both desktop
	  and server systems.

	  This is the default I/O scheduler.

config IOSCHED_SIO
	tristate "Simple I/O scheduler"
	default n
	---help---
	  Simple I/O aims to keep minimum overhead to achieve low latency to 
	  serve I/O requests. No priority queue concepts, but only basic merging. 
	  SIO is a mix between noop & deadline. No reordering or sorting of requests.

config IOSCHED_ZEN
	tristate "Zen I/O scheduler"
	default n
	---help---
	  ZEN is based on the Noop, Deadline and SIO I/O schedulers. It's an FCFS 
	  (First come, first serve) based algorithm, but it's not strictly FIFO. ZEN 
	  does not do any sorting. It uses deadlines for fairness, and treats synchronous 
	  requests with priority over asynchronous ones. Other than that, it's pretty 
	  much the same as Noop blended with VR features. 
	
config CFQ_GROUP_IOSCHED
	bool "CFQ Group Scheduling support"
	depends on IOSCHED_CFQ && BLK_CGROUP
	default n
	---help---
	  Enable group IO scheduling in CFQ.

choice
	prompt "Default I/O scheduler"
	default DEFAULT_CFQ
	help
	  Select the I/O scheduler which will be used by default for all
	  block devices.

	config DEFAULT_DEADLINE
		bool "Deadline" if IOSCHED_DEADLINE=y

	config DEFAULT_CFQ
		bool "CFQ" if IOSCHED_CFQ=y

	config DEFAULT_NOOP
		bool "No-op"


endchoice

config DEFAULT_IOSCHED
	string
	default "deadline" if DEFAULT_DEADLINE
	default "cfq" if DEFAULT_CFQ
	default "noop" if DEFAULT_NOOP
	default "sio" if DEFAULT_SIO
	default "zen" if DEFAULT_ZEN

endmenu

endif
```
